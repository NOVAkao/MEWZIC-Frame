## sdkconfig.defaults
```kconfig
#
# Bluetooth
#

CONFIG_BT_ENABLED=y
CONFIG_BT_BLUEDROID_ENABLED=n
CONFIG_BT_CONTROLLER_ONLY=y

#
# Bluetooth Dual Mode
#

CONFIG_BTDM_CTRL_MODE_BTDM=y
CONFIG_BTDM_CTRL_MODE_BR_EDR_ONLY=n
CONFIG_BTDM_CTRL_BR_EDR_SCO_DATA_PATH_HCI=y

#
# BTstack
#

CONFIG_BTSTACK_INTERNAL_BT=y
CONFIG_BTSTACK_EXTERNAL_UART_BT=n
CONFIG_BTSTACK_AUDIO=n
CONFIG_BTSTACK_HCI_DUMP_STDOUT=n

#
# Application
#

CONFIG_ESP_MAIN_TASK_STACK_SIZE=8192

#
# BTstack timing
#

CONFIG_FREERTOS_HZ=1000
```
